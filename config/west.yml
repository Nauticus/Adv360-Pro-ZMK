## config/west.yml
```yaml
manifest:
  remotes:
    - name: zmkfirmware
      url-base: https://github.com/zmkfirmware
    - name: nauticus
      url-base: https://github.com/Nauticus
  projects:
    - name: zmk
      remote: nauticus
      revision: main
      import: app/west.yml
  self:
    path: config
```
